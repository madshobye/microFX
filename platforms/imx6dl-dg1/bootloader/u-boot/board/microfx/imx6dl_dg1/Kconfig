## platforms/imx6dl-dg1/bootloader/u-boot/board/microfx/imx6dl_dg1/Kconfig
```kconfig
if TARGET_MICROFX_IMX6DL_DG1

config SYS_BOARD
	default "imx6dl_dg1"

config SYS_VENDOR
	default "microfx"

config SYS_CONFIG_NAME
	default "imx6dl_dg1"

config IMX_CONFIG
	default "board/microfx/imx6dl_dg1/imximage.cfg"

endif
```

## platforms/imx6dl-dg1/bootloader/u-boot/configs/microfx_imx6dl_dg1_defconfig
```kconfig
CONFIG_ARM=y
CONFIG_ARCH_MX6=y
CONFIG_TEXT_BASE=0x17800000
CONFIG_SYS_MALLOC_LEN=0xa00000
CONFIG_NR_DRAM_BANKS=1
CONFIG_ENV_SIZE=0x2000
CONFIG_MX6QDL=y
CONFIG_TARGET_MICROFX_IMX6DL_DG1=y
CONFIG_DEFAULT_DEVICE_TREE="imx6dl-microfx-dg1"
CONFIG_SYS_MONITOR_LEN=409600
CONFIG_BOOTDELAY=2
# The prototype boots only a Linux zImage. Keeping EFI disabled also avoids
# making the isolated build depend on host GnuTLS just to create EFI capsules.
# CONFIG_EFI_LOADER is not set
# CONFIG_TOOLS_MKEFICAPSULE is not set
CONFIG_USE_BOOTCOMMAND=y
CONFIG_BOOTCOMMAND="mmc dev ${mmcdev}; if mmc rescan; then run import_slot; if test ${active_slot} = b; then run boot_b || run boot_a; else run boot_a || run boot_b; fi; fi"
CONFIG_SYS_PBSIZE=532
CONFIG_BOARD_EARLY_INIT_F=y
CONFIG_HUSH_PARSER=y
CONFIG_SYS_MAXARGS=32
CONFIG_CMD_BOOTZ=y
CONFIG_CMD_MEMTEST=y
CONFIG_SYS_MEMTEST_START=0x10000000
CONFIG_SYS_MEMTEST_END=0x18000000
CONFIG_CMD_MMC=y
CONFIG_CMD_PART=y
CONFIG_CMD_CACHE=y
CONFIG_CMD_EXT2=y
CONFIG_CMD_EXT4=y
CONFIG_CMD_FS_GENERIC=y
CONFIG_CMD_IMPORTENV=y
CONFIG_OF_CONTROL=y
CONFIG_ENV_IS_NOWHERE=y
CONFIG_BOUNCE_BUFFER=y
CONFIG_DM=y
CONFIG_DM_GPIO=y
CONFIG_DM_MMC=y
CONFIG_FSL_USDHC=y
CONFIG_PINCTRL=y
CONFIG_PINCTRL_IMX6=y
CONFIG_DM_SERIAL=y
CONFIG_MXC_UART=y
CONFIG_IMX_WATCHDOG=y
```

## platforms/imx6dl-dg1/buildroot/Config.in
```kconfig
source "$BR2_EXTERNAL_IMX6DL_DG1_PATH/package/raylib-drm/Config.in"
source "$BR2_EXTERNAL_IMX6DL_DG1_PATH/package/hdf5-microfx/Config.in"
source "$BR2_EXTERNAL_IMX6DL_DG1_PATH/package/usrsctp-microfx/Config.in"
source "$BR2_EXTERNAL_IMX6DL_DG1_PATH/package/libpeer-microfx/Config.in"
source "$BR2_EXTERNAL_IMX6DL_DG1_PATH/package/microfx-demo/Config.in"
source "$BR2_EXTERNAL_IMX6DL_DG1_PATH/package/microfx-peer-bridge/Config.in"
source "$BR2_EXTERNAL_IMX6DL_DG1_PATH/package/microfx-provision/Config.in"
```

## platforms/imx6dl-dg1/buildroot/configs/imx6dl_dg1_defconfig
```kconfig
BR2_arm=y
BR2_cortex_a9=y
BR2_ARM_ENABLE_NEON=y
BR2_ARM_ENABLE_VFP=y
BR2_ARM_EABIHF=y
BR2_TOOLCHAIN_BUILDROOT_GLIBC=y
BR2_TOOLCHAIN_BUILDROOT_CXX=y
BR2_KERNEL_HEADERS_6_12=y
BR2_TARGET_GENERIC_HOSTNAME="microfx"
BR2_TARGET_GENERIC_ISSUE="GPU graphics appliance"
BR2_INIT_BUSYBOX=y
BR2_ROOTFS_DEVICE_CREATION_DYNAMIC_EUDEV=y
BR2_SYSTEM_DEFAULT_PATH="/bin:/sbin:/usr/bin:/usr/sbin"
BR2_ROOTFS_OVERLAY="$(BR2_EXTERNAL_IMX6DL_DG1_PATH)/board/imx6dl-dg1/rootfs-overlay"
BR2_LINUX_KERNEL=y
BR2_LINUX_KERNEL_CUSTOM_VERSION=y
BR2_LINUX_KERNEL_CUSTOM_VERSION_VALUE="6.12.98"
BR2_LINUX_KERNEL_DEFCONFIG="imx_v6_v7"
BR2_LINUX_KERNEL_CONFIG_FRAGMENT_FILES="$(BR2_EXTERNAL_IMX6DL_DG1_PATH)/board/imx6dl-dg1/linux.fragment"
BR2_LINUX_KERNEL_DTS_SUPPORT=y
BR2_LINUX_KERNEL_CUSTOM_DTS_PATH="$(BR2_EXTERNAL_IMX6DL_DG1_PATH)/board/imx6dl-dg1/imx6dl-microfx-dg1.dts"
BR2_LINUX_KERNEL_INSTALL_TARGET=y
BR2_LINUX_KERNEL_NEEDS_HOST_OPENSSL=y
BR2_PACKAGE_BUSYBOX_SHOW_OTHERS=y
BR2_PACKAGE_KMOD=y
BR2_PACKAGE_LIBDRM=y
BR2_PACKAGE_LIBDRM_ETNAVIV=y
BR2_PACKAGE_MESA3D=y
BR2_PACKAGE_MESA3D_GALLIUM_DRIVER_ETNAVIV=y
BR2_PACKAGE_MESA3D_GALLIUM_DRIVER_KMSRO=y
BR2_PACKAGE_MESA3D_OPENGL_EGL=y
BR2_PACKAGE_MESA3D_OPENGL_ES=y
BR2_PACKAGE_LIBINPUT=y
BR2_PACKAGE_RAYLIB_DRM=y
BR2_PACKAGE_HDF5_MICROFX=y
BR2_PACKAGE_QUICKJS=y
BR2_PACKAGE_LIBQRENCODE=y
BR2_PACKAGE_LIBQRENCODE_TOOLS=y
BR2_PACKAGE_MICROFX_DEMO=y
BR2_PACKAGE_MICROFX_PROVISION=y
BR2_PACKAGE_MICROFX_PEER_BRIDGE=y
BR2_PACKAGE_CA_CERTIFICATES=y
BR2_PACKAGE_LIBCURL=y
BR2_PACKAGE_LIBCURL_CURL=y
BR2_PACKAGE_MBEDTLS=y
BR2_PACKAGE_LIBCURL_MBEDTLS=y
BR2_PACKAGE_WPA_SUPPLICANT=y
BR2_PACKAGE_WPA_SUPPLICANT_CLI=y
BR2_PACKAGE_WPA_SUPPLICANT_PASSPHRASE=y
BR2_PACKAGE_IW=y
BR2_PACKAGE_WIRELESS_REGDB=y
BR2_PACKAGE_DROPBEAR=y
BR2_PACKAGE_DROPBEAR_CLIENT=n
BR2_PACKAGE_DROPBEAR_DISABLE_REVERSEDNS=y
BR2_PACKAGE_HOSTAPD=y
BR2_PACKAGE_DNSMASQ=y
BR2_PACKAGE_LINUX_FIRMWARE=y
BR2_PACKAGE_LINUX_FIRMWARE_ATHEROS_6002=y
BR2_PACKAGE_LINUX_FIRMWARE_ATHEROS_6003=y
BR2_TARGET_ROOTFS_EXT2=y
BR2_TARGET_ROOTFS_EXT2_4=y
BR2_TARGET_ROOTFS_EXT2_SIZE="1536M"
BR2_TARGET_ROOTFS_EXT2_INODES=32768
BR2_TARGET_ROOTFS_EXT2_RESBLKS=0
BR2_TARGET_ROOTFS_EXT2_LABEL="microfx-root"
BR2_TARGET_ROOTFS_TAR=n
BR2_ROOTFS_POST_BUILD_SCRIPT="$(BR2_EXTERNAL_IMX6DL_DG1_PATH)/board/imx6dl-dg1/post-build.sh"
BR2_ROOTFS_POST_IMAGE_SCRIPT="$(BR2_EXTERNAL_IMX6DL_DG1_PATH)/board/imx6dl-dg1/post-image.sh"
BR2_PACKAGE_BUSYBOX_CONFIG_FRAGMENT_FILES="$(BR2_EXTERNAL_IMX6DL_DG1_PATH)/board/imx6dl-dg1/busybox.fragment"
```

## platforms/imx6dl-dg1/buildroot/package/hdf5-microfx/Config.in
```kconfig
config BR2_PACKAGE_HDF5_MICROFX
	bool "HDF5 runtime library"
	select BR2_PACKAGE_ZLIB
	help
	  HDF5 C and high-level libraries used by the generic microFX JavaScript
	  scientific-data decoder.
```

## platforms/imx6dl-dg1/buildroot/package/libpeer-microfx/Config.in
```kconfig
config BR2_PACKAGE_LIBPEER_MICROFX
	bool "libpeer for the peer bridge"
	select BR2_PACKAGE_MBEDTLS
	select BR2_PACKAGE_MBEDTLS_DTLS_SRTP
	select BR2_PACKAGE_LIBSRTP
	select BR2_PACKAGE_USRSCTP_MICROFX
	help
	  Embedded WebRTC DataChannel library used by the optional project
	  PeerJS bridge. Full usrsctp is enabled for fragmented code/assets.
```

## platforms/imx6dl-dg1/buildroot/package/microfx-demo/Config.in
```kconfig
config BR2_PACKAGE_MICROFX_DEMO
	bool "graphics demo"
	depends on BR2_PACKAGE_RAYLIB_DRM
	select BR2_PACKAGE_QUICKJS
	help
	  Boot-to-HDMI accelerated graphics demonstration.
```

## platforms/imx6dl-dg1/buildroot/package/microfx-peer-bridge/Config.in
```kconfig
config BR2_PACKAGE_MICROFX_PEER_BRIDGE
	bool "PeerJS project bridge"
	depends on BR2_TOOLCHAIN_HAS_THREADS
	depends on !BR2_STATIC_LIBS
	select BR2_PACKAGE_LIBPEER_MICROFX
	select BR2_PACKAGE_CJSON
	select BR2_PACKAGE_LIBWEBSOCKETS
	help
	  Optional PeerJS DataChannel service for editing graphics projects.
```

## platforms/imx6dl-dg1/buildroot/package/microfx-provision/Config.in
```kconfig
config BR2_PACKAGE_MICROFX_PROVISION
	bool "captive provisioning"
	select BR2_PACKAGE_HOSTAPD
	select BR2_PACKAGE_DNSMASQ
	help
	  Concurrent setup AP, captive portal, and persistent Wi-Fi configuration.
```

## platforms/imx6dl-dg1/buildroot/package/raylib-drm/Config.in
```kconfig
config BR2_PACKAGE_RAYLIB_DRM
	bool "raylib (DRM/KMS)"
	depends on BR2_TOOLCHAIN_HAS_THREADS
	depends on BR2_PACKAGE_MESA3D_OPENGL_EGL
	depends on BR2_PACKAGE_MESA3D_OPENGL_ES
	select BR2_PACKAGE_LIBDRM
	help
	  raylib built for direct DRM/KMS and OpenGL ES 2, without X11.
```

## platforms/imx6dl-dg1/buildroot/package/usrsctp-microfx/Config.in
```kconfig
config BR2_PACKAGE_USRSCTP_MICROFX
	bool "usrsctp for the peer bridge"
	depends on BR2_TOOLCHAIN_HAS_THREADS
	help
	  Full userspace SCTP implementation used by libpeer for reliable,
	  fragmented WebRTC DataChannel project and asset transfers.
```
